# file: TEST.ioc
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Mcu.Family=STM32F4
RCC.CortexFreq_Value=168000000
ARM.CMSIS.5.6.0.CMSISJjDSP=Library
RCC.APB1CLKDivider=RCC_HCLK_DIV4
RCC.SYSCLKSource=RCC_SYSCLKSOURCE_PLLCLK
ProjectManager.StackSize=0x8000
ProjectManager.TargetToolchain=MDK-ARM V5.27
RCC.HCLKFreq_Value=168000000
RCC.APB2TimFreq_Value=168000000
RCC.LSE_VALUE=32768
RCC.AHBFreq_Value=168000000
ARM.CMSIS.5.6.0.CMSISJjCORE=true
RCC.HSE_VALUE=25000000
board=custom
RCC.VCOOutputFreq_Value=336000000
RCC.APB2Freq_Value=84000000
Mcu.Name=STM32F407V(E-G)Tx
RCC.48MHZClocksFreq_Value=84000000
RCC.SYSCLKFreq_VALUE=168000000
Mcu.Package=LQFP100
ProjectManager.HeapSize=0x2000
RCC.HSI_VALUE=16000000
NVIC.PriorityGroup=NVIC_PRIORITYGROUP_4
RCC.APB2CLKDivider=RCC_HCLK_DIV2
RCC.PLLM=8
RCC.PLLN=168
RCC.APB1TimFreq_Value=84000000
RCC.APB1Freq_Value=42000000

// file: Src/main.c
/* USER CODE BEGIN Header */
/**
  ******************************************************************************
  * @file           : main.c
  * @brief          : Main program body
  ******************************************************************************
  * @attention
  *
  * <h2><center>&copy; Copyright (c) 2020 STMicroelectronics.
  * All rights reserved.</center></h2>
  *
  * This software component is licensed by ST under Ultimate Liberty license
  * SLA0044, the "License"; You may not use this file except in compliance with
  * the License. You may obtain a copy of the License at:
  *                             www.st.com/SLA0044
  *
  ******************************************************************************
  */
/* USER CODE END Header */

#include "main.h"

/* USER CODE BEGIN Includes */
#include "arm_math.h"
#include <stdio.h>
#include <math.h>
#include <stdlib.h>
#include "dsp.h"
/* USER CODE END Includes */

/* USER CODE BEGIN PD */
#define FFT_N 256
#define FFT_M 100
#define SIG_LEN 2000

/* USER CODE END PD */

/* USER CODE BEGIN PV */
	volatile uint16_t n = FFT_N, m = FFT_M;
	float signal[SIG_LEN] = {1,2,3,4,5,6,7,8,9,10,11,12,13,14,15};
	float frame[129*18];
	volatile float melb[20*129];
	volatile float result[20*18];
	volatile float final[20*18];
	volatile float ham[FFT_N];
	volatile dsp_return status1;
	volatile arm_status status2;
/* USER CODE END PV */

void SystemClock_Config(void);

int main(void)
{

  /* MCU Configuration--------------------------------------------------------*/

  /* Reset of all peripherals, Initializes the Flash interface and the Systick. */
  HAL_Init();

  /* Configure the system clock */
  SystemClock_Config();

  /* Initialize all configured peripherals */
  /* USER CODE BEGIN 2 */
  arm_matrix_instance_f32 fb;
	arm_matrix_instance_f32 fr;
	arm_matrix_instance_f32 res;
	arm_mat_init_f32(&fb, 20, 129, (float32_t *)melb);
	arm_mat_init_f32(&fr, 129, 18, (float32_t *)frame);
	arm_mat_init_f32(&res, 20, 18, result);

	hamming(ham, n);
  status1 = block_frames(frame, signal, ham, sizeof(signal)/sizeof(float), m, n);
	mel_filterbank(melb, 20, 256, 8000);

  status2 = arm_mat_mult_f32(&fb, &fr, &res);

	volatile float invect[20], outvect[20];
	uint8_t k = 0;
	for(uint8_t j = 0; j < 18; j++)
	{
		k = 0;
		for(uint8_t i = 0; i < 20; i++)
		{
			invect[k++] = result[i*18+j];
		}
		dct_log_transform(outvect, invect, 20);
		k = 0;
		for(uint8_t i = 0; i < 20; i++)
		{
			final[i*18+j] = outvect[k++];
		}
	}
	volatile float fec = 0.0f/0.0f;

  /* USER CODE END 2 */

  /* Infinite loop */
  while (1)
  {

  }
}

void SystemClock_Config(void)
{
  RCC_OscInitTypeDef RCC_OscInitStruct = {0};
  RCC_ClkInitTypeDef RCC_ClkInitStruct = {0};

  /** Configure the main internal regulator output voltage
  */
  __HAL_RCC_PWR_CLK_ENABLE();
  __HAL_PWR_VOLTAGESCALING_CONFIG(PWR_REGULATOR_VOLTAGE_SCALE1);
  /** Initializes the CPU, AHB and APB busses clocks
  */
  RCC_OscInitStruct.OscillatorType = RCC_OSCILLATORTYPE_HSI;
  RCC_OscInitStruct.HSIState = RCC_HSI_ON;
  RCC_OscInitStruct.HSICalibrationValue = RCC_HSICALIBRATION_DEFAULT;
  RCC_OscInitStruct.PLL.PLLState = RCC_PLL_ON;
  RCC_OscInitStruct.PLL.PLLSource = RCC_PLLSOURCE_HSI;
  RCC_OscInitStruct.PLL.PLLM = 8;
  RCC_OscInitStruct.PLL.PLLN = 168;
  RCC_OscInitStruct.PLL.PLLP = RCC_PLLP_DIV2;
  RCC_OscInitStruct.PLL.PLLQ = 4;
  if (HAL_RCC_OscConfig(&RCC_OscInitStruct) != HAL_OK)
  {
    Error_Handler();
  }
  /** Initializes the CPU, AHB and APB busses clocks
  */
  RCC_ClkInitStruct.ClockType = RCC_CLOCKTYPE_HCLK|RCC_CLOCKTYPE_SYSCLK
                              |RCC_CLOCKTYPE_PCLK1|RCC_CLOCKTYPE_PCLK2;
  RCC_ClkInitStruct.SYSCLKSource = RCC_SYSCLKSOURCE_PLLCLK;
  RCC_ClkInitStruct.AHBCLKDivider = RCC_SYSCLK_DIV1;
  RCC_ClkInitStruct.APB1CLKDivider = RCC_HCLK_DIV4;
  RCC_ClkInitStruct.APB2CLKDivider = RCC_HCLK_DIV2;

  if (HAL_RCC_ClockConfig(&RCC_ClkInitStruct, FLASH_LATENCY_5) != HAL_OK)
  {
    Error_Handler();
  }
}

void Error_Handler(void)
{
}

/************************ (C) COPYRIGHT STMicroelectronics *****END OF FILE****/
